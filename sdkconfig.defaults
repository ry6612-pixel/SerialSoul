## sdkconfig.defaults
```kconfig
# ZeroClaw ESP32-S3 standalone AI firmware - ESP-IDF config

# Main task stack: 48KB (BLE coexistence needs more free internal SRAM)
CONFIG_MAIN_TASK_STACK_SIZE=49152

# pthread default stack (reduced from 8KB to save internal SRAM)
CONFIG_PTHREAD_TASK_STACK_SIZE_DEFAULT=4096
CONFIG_ESP_TIMER_TASK_STACK_SIZE=4096

# Allow thread stacks in PSRAM when internal RAM is low
CONFIG_SPIRAM_ALLOW_STACK_EXTERNAL_MEMORY=y

# Relax watchdog budgets for TLS-heavy network requests on ESP32-S3
CONFIG_ESP_INT_WDT=y
CONFIG_ESP_INT_WDT_TIMEOUT_MS=1600
CONFIG_ESP_TASK_WDT=y
CONFIG_ESP_TASK_WDT_TIMEOUT_S=12

# Enable PSRAM (board has 8MB)
CONFIG_ESP32S3_SPIRAM_SUPPORT=y
CONFIG_SPIRAM=y
CONFIG_SPIRAM_MODE_OCT=y
CONFIG_SPIRAM_SPEED_80M=y

# Allow malloc to use PSRAM
CONFIG_SPIRAM_USE_MALLOC=y
CONFIG_SPIRAM_MALLOC_ALWAYSINTERNAL=4096

# Custom partition table for OTA
CONFIG_PARTITION_TABLE_CUSTOM=y
CONFIG_PARTITION_TABLE_CUSTOM_FILENAME="partitions.csv"
CONFIG_PARTITION_TABLE_OFFSET=0x8000
CONFIG_BOOTLOADER_APP_ROLLBACK_ENABLE=y

# Flash size: 16MB (ESP32-S3 N16R8)
CONFIG_ESPTOOLPY_FLASHSIZE_16MB=y

# HTTPS support
CONFIG_ESP_TLS_USING_MBEDTLS=y
CONFIG_MBEDTLS_CERTIFICATE_BUNDLE=y
CONFIG_MBEDTLS_CERTIFICATE_BUNDLE_DEFAULT_FULL=y

# Let mbedTLS use default malloc (can fall back to PSRAM when internal RAM is low)
CONFIG_MBEDTLS_DEFAULT_MEM_ALLOC=y

# BLE (NimBLE) for mobile provisioning
CONFIG_BT_ENABLED=y
CONFIG_BT_NIMBLE_ENABLED=y
CONFIG_BT_NIMBLE_MAX_CONNECTIONS=1
CONFIG_BT_NIMBLE_ROLE_PERIPHERAL=y
CONFIG_BT_NIMBLE_ROLE_BROADCASTER=y
CONFIG_BT_NIMBLE_ROLE_CENTRAL=n
CONFIG_BT_NIMBLE_ROLE_OBSERVER=n
CONFIG_BT_NIMBLE_GAP_DEVICE_NAME_MAX_LEN=32
CONFIG_BT_NIMBLE_ATT_PREFERRED_MTU=128
CONFIG_BT_NIMBLE_MEM_ALLOC_MODE_EXTERNAL=y
CONFIG_BT_NIMBLE_MSYS_1_BLOCK_COUNT=2
CONFIG_BT_NIMBLE_MSYS_1_BLOCK_SIZE=64

# WiFi + BT coexistence
CONFIG_ESP_COEX_SW_COEXIST_ENABLE=y

# ESP-SR: Wake word detection (local, offline)
CONFIG_USE_WAKENET=y
CONFIG_SR_WN_WN9_HIESP=y
CONFIG_SR_WN_WN9_HIESP=y
```
